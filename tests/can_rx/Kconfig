## tests/can_rx/testcase.yaml
```yaml
tests:
  can_rx.testing.ztest:
    build_only: false
    platform_allow:
      - native_sim
    integration_platforms:
      - native_sim
    tags: test_framework
```
