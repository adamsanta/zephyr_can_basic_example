## CMakeLists.txt
```
cmake_minimum_required(VERSION 3.20.0)

set(BOARD "frdm_mcxn947/mcxn947/cpu0")

find_package(Zephyr REQUIRED HINTS $ENV{ZEPHYR_BASE})
project(zephyr_can_basic_example)

target_sources(app PRIVATE
    src/main.c
    src/can_rx.c
    src/can_tx.c
)
```

## Kconfig
```
mainmenu "Zephyr CAN Example"

config CAN_TX1_ID
    hex "TX1 message CAN ID"
    range 0x0 0x1FFFFFFF
    default 0x11
    help
      CAN identifier for the message sent by TX1 thread.
    
config CAN_TX2_ID
    hex "TX2 message CAN ID"
    range 0x0 0x1FFFFFFF
    default 0x22
    help
      CAN identifier for the message sent by TX2 thread.

config CAN_TX3_ID
    hex "TX3 message CAN ID"
    range 0x0 0x1FFFFFFF
    default 0x33
    help
      CAN identifier for the message sent by TX3 thread.

config CAN_TX1_DLC
    int "TX1 message CAN DLC"
    range 0 8
    default 1
    help
      CAN Data Length of the message sent by TX1 thread.
    
config CAN_TX2_DLC
    int "TX2 message CAN DLC"
    range 0 8
    default 4
    help
      CAN Data Length of the message sent by TX2 thread.

config CAN_TX3_DLC
    int "TX3 message CAN DLC"
    range 0 8
    default 8
    help
      CAN Data Length of the message sent by TX3 thread.

config CAN_TX1_PERIOD_MS
    int "TX1 message period (ms)"
    default 50
    help
        Sending period for the message sent by TX1 thread.

config CAN_TX2_PERIOD_MS
    int "TX2 message period (ms)"
    default 250
    help
        Sending period for the message sent by TX2 thread.

config CAN_TX3_PERIOD_MS
    int "TX3 message period (ms)"
    default 500
    help
        Sending period for the message sent by TX3 thread.

config START_MSG
    bool "Enable start CAN message"
    default y
    help
      Activate the possibility to start printing messages

config START_MSG_ID
    hex "Start printing CAN ID"
    range 0x0 0x1FFFFFFF
    default 0x200
    depends on START_MSG
    help
      CAN ID of the message for starting printing

config STOP_MSG
    bool "Enable stop CAN message"
    default y
    help
      Activate the possibility to stop printing messages

config STOP_MSG_ID
    hex "Stop printing CAN ID"
    range 0x0 0x1FFFFFFF
    default 0x201
    depends on STOP_MSG
    help
      CAN ID of the message for stopping printing

config HELLO_MSG
    bool "Enable hello CAN message"
    default y
    help
      Activate the possibility to print hello world

config HELLO_MSG_ID
    hex "Hello trigger CAN ID"
    range 0x0 0x1FFFFFFF
    default 0x202
    depends on HELLO_MSG
    help
      CAN ID of the message for printing hello world

config CAN_BITRATE
    int "CAN bitrate"
    range 1 1000000
    default 500000
    help
      Bitrate to set for the CAN peripheral used by the program

source "Kconfig.zephyr"
```

## prj.conf
```kconfig
CONFIG_CAN=y
CONFIG_TEST_RANDOM_GENERATOR=y
```

## src/main.c
```c
#include <stdio.h>

#include "can_tx.h"
#include "can_rx.h"

/*
* Threads configuration and creation (STARTS)
*
* RX_THREAD receives CAN frames and prints their content, or 'Hello World',
* to UART if enabled with the START message. Priting can be disabled with the STOP
* message.
* TX1_THREAD periodically transmits the message assigned to it, same thing for
* TX2 and TX3.
*/

// RX is more timing-sensitive than TX, hence the higher priority
#define CAN_RX_THREAD_STACK_SIZE 512
#define CAN_RX_THREAD_PRIORITY 1
#define CAN_TX1_THREAD_STACK_SIZE 512
#define CAN_TX1_THREAD_PRIORITY 2
#define CAN_TX2_THREAD_STACK_SIZE 512
#define CAN_TX2_THREAD_PRIORITY 2
#define CAN_TX3_THREAD_STACK_SIZE 512
#define CAN_TX3_THREAD_PRIORITY 2

K_THREAD_STACK_DEFINE(can_rx_thread_stack, CAN_RX_THREAD_STACK_SIZE);
K_THREAD_STACK_DEFINE(can_tx1_thread_stack, CAN_TX1_THREAD_STACK_SIZE);
K_THREAD_STACK_DEFINE(can_tx2_thread_stack, CAN_TX2_THREAD_STACK_SIZE);
K_THREAD_STACK_DEFINE(can_tx3_thread_stack, CAN_TX3_THREAD_STACK_SIZE);

struct k_thread can_rx_thread_data;
struct k_thread can_tx1_thread_data;
struct k_thread can_tx2_thread_data;
struct k_thread can_tx3_thread_data;

K_THREAD_DEFINE(can_rx_tid, CAN_RX_THREAD_STACK_SIZE,
                can_rx_thread,
                NULL, NULL, NULL,
                CAN_RX_THREAD_PRIORITY, 0, 0);
K_THREAD_DEFINE(can_tx1_tid, CAN_TX1_THREAD_STACK_SIZE,
                can_tx1_thread,
                NULL, NULL, NULL,
                CAN_TX1_THREAD_PRIORITY, 0, 0);
K_THREAD_DEFINE(can_tx2_tid, CAN_TX2_THREAD_STACK_SIZE,
                can_tx2_thread,
                NULL, NULL, NULL,
                CAN_TX2_THREAD_PRIORITY, 0, 0);
K_THREAD_DEFINE(can_tx3_tid, CAN_TX3_THREAD_STACK_SIZE,
                can_tx3_thread,
                NULL, NULL, NULL,
                CAN_TX3_THREAD_PRIORITY, 0, 0);

/* Threads configuration and creation (ENDS) */

// Default Zephyr CAN device is used (refer to board's dts file)
const struct device *const can_dev = DEVICE_DT_GET(DT_CHOSEN(zephyr_canbus));

/**
  * @brief  Initialize the CAN peripheral and prints instructions
  */
int main(void)
{
	int ret;

	if (!device_is_ready(can_dev)) {
		printk("CAN: Device %s not ready.\n", can_dev->name);
		return 0;
	}

	can_set_bitrate(can_dev, CONFIG_CAN_BITRATE);

	ret = can_start(can_dev);
	if (ret != 0) {
		printk("Error starting CAN controller [%d]", ret);
		return 0;
	}

	printk("Initialization done.\n");
#if IS_ENABLED(CONFIG_START_MSG)
		printk("Send 0x%x CAN ID to start printing (whatever the dlc and data).\n", CONFIG_START_MSG_ID);
#endif
#if IS_ENABLED(CONFIG_STOP_MSG)	
		printk("Send 0x%x CAN ID to stop printing (whatever the dlc and data).\n", CONFIG_STOP_MSG_ID);
#endif
#if IS_ENABLED(CONFIG_HELLO_MSG)	
		printk("Send 0x%x CAN ID to print 'Hello World' (whatever the dlc and data).\n", CONFIG_HELLO_MSG_ID);
#endif
}
```

## src/can_common.h
```c
#include <zephyr/drivers/can.h>

// can_dev is defined in main.c
extern const struct device *const can_dev;
```

## src/can_rx.c
```c
#include "can_rx.h"

// can_rx_msgq is a queue storing the received CAN frames.
// 2 as a maximum number of frames in the queue is enough for manual testing.
// It might need to be increased in case of heavy CAN bus activity.
CAN_MSGQ_DEFINE(can_rx_msgq, 2);

/**
  * @brief  Print information about a received CAN frame if enabled
  * with CONFIG_START_MSG_ID, print 'Hello World' if requested
  * with CONFIG_HELLO_MSG_ID, or disable printing with CONFIG_STOP_MSG_ID.
  * @param  frame: Frame for which to print the information.
  * @param  printing_enabled: true if printing enabled, false if disabled.
  */
void process_can_frame(struct can_frame *frame, bool *printing_enabled){

#if IS_ENABLED(CONFIG_START_MSG)
	if (frame->id == CONFIG_START_MSG_ID){
		*printing_enabled = true;
	}
#endif
	
#if IS_ENABLED(CONFIG_STOP_MSG)
	if(frame->id == CONFIG_STOP_MSG_ID){
		*printing_enabled = false;
	}
#endif

	if (*printing_enabled){
		// Get timestamp
		uint32_t ts = k_uptime_get_32();

#if IS_ENABLED(CONFIG_HELLO_MSG)
		if (frame->id == CONFIG_HELLO_MSG_ID){
			printk("Hello World\n");
		}
#endif

		// Print CAN frame information with timestamp
		printk("[%u ms] ID:0x%03X DLC:%d DATA:", ts, frame->id, frame->dlc);
		for (int i = 0; i < frame->dlc; i++) {
			printk("%02X ", frame->data[i]);
		}
		printk("\n");
	}
}

/**
  * @brief  Receive any CAN frame and process it with process_can_frame.
  */
void can_rx_thread(void *arg1, void *arg2, void *arg3)
{
	ARG_UNUSED(arg1);
	ARG_UNUSED(arg2);
	ARG_UNUSED(arg3);

	int filter_id;
	bool printing_enabled;
	struct can_frame frame;

	// Filters define the types of CAN frame to accept.
	// We want anyframe: with standard and extended IDs.
	struct can_filter std_id_filter = {
		.id = 0,
		.mask = 0,
	};
	struct can_filter ext_id_filter = {
		.id = 0,
		.mask = 0,
		.flags = CAN_FILTER_IDE,
	};

	filter_id = can_add_rx_filter_msgq(can_dev, &can_rx_msgq, &std_id_filter);
	if (filter_id < 0) {
		printk("Failed to add standard ID CAN filter\n");
	}

	filter_id = can_add_rx_filter_msgq(can_dev, &can_rx_msgq, &ext_id_filter);
	if (filter_id < 0) {
		printk("Failed to add extended ID CAN filter\n");
	}

	// If START message is undefined, printing starts immediately.
#if IS_ENABLED(CONFIG_START_MSG)
	printing_enabled = false;
#else
	printing_enabled = true;
#endif

    while (1) {
        if (k_msgq_get(&can_rx_msgq, &frame, K_FOREVER) == 0) {
			process_can_frame(&frame, &printing_enabled);
        }
		else{
			printk("CAN message reception with k_msgq_get raised an error\n");
		}
    }
}
```

## src/can_rx.h
```c
#include "can_common.h"

void process_can_frame(struct can_frame *frame, bool *printing_enabled);
void can_rx_thread(void *arg1, void *arg2, void *arg3);
```

## src/can_tx.c
```c
#include "can_tx.h"

/**
  * @brief  Transmit a CAN message every CONFIG_CAN_TX1_PERIOD_MS ms
  * with ID=CONFIG_CAN_TX1_ID, DLC=CONFIG_CAN_TX1_DLC and random data.
  */
void can_tx1_thread(void *arg1, void *arg2, void *arg3)
{
	ARG_UNUSED(arg1);
	ARG_UNUSED(arg2);
	ARG_UNUSED(arg3);

	int i;
	struct can_frame can_tx1_frame = {
		.id = CONFIG_CAN_TX1_ID,
		.dlc = CONFIG_CAN_TX1_DLC,
		.flags = CAN_FILTER_IDE,
	};

	while(1){
		for (i=0;i<can_tx1_frame.dlc;i++){
			// Generate random data
    		can_tx1_frame.data[i] = sys_rand8_get();
		}
		can_send(can_dev, &can_tx1_frame, K_FOREVER, NULL, NULL);
		k_sleep(CAN_TX1_PERIOD);
	}
}

/**
  * @brief  Transmit a CAN message every CONFIG_CAN_TX2_PERIOD_MS ms
  * with ID=CONFIG_CAN_TX2_ID, DLC=CONFIG_CAN_TX2_DLC and random data.
  */
void can_tx2_thread(void *arg1, void *arg2, void *arg3)
{
	ARG_UNUSED(arg1);
	ARG_UNUSED(arg2);
	ARG_UNUSED(arg3);

	int i;
	struct can_frame can_tx2_frame = {
		.id = CONFIG_CAN_TX2_ID,
		.dlc = CONFIG_CAN_TX2_DLC,
		.flags = CAN_FILTER_IDE,
	};

	while(1){
		for (i=0;i<can_tx2_frame.dlc;i++){
			// Generate random data
    		can_tx2_frame.data[i] = sys_rand8_get();
		}
		can_send(can_dev, &can_tx2_frame, K_FOREVER, NULL, NULL);
		k_sleep(CAN_TX2_PERIOD);
	}
}

/**
  * @brief  Transmit a CAN message every CONFIG_CAN_TX3_PERIOD_MS ms
  * with ID=CONFIG_CAN_TX3_ID, DLC=CONFIG_CAN_TX3_DLC and random data.
  */
void can_tx3_thread(void *arg1, void *arg2, void *arg3)
{
	ARG_UNUSED(arg1);
	ARG_UNUSED(arg2);
	ARG_UNUSED(arg3);

	int i;
	struct can_frame can_tx3_frame = {
		.id = CONFIG_CAN_TX3_ID,
		.dlc = CONFIG_CAN_TX3_DLC,
		.flags = CAN_FILTER_IDE,
	};

	while(1){
		for (i=0;i<can_tx3_frame.dlc;i++){
			// Generate random data
    		can_tx3_frame.data[i] = sys_rand8_get();
		}
		can_send(can_dev, &can_tx3_frame, K_FOREVER, NULL, NULL);
		k_sleep(CAN_TX3_PERIOD);
	}
}
```

## src/can_tx.h
```c
#include "can_common.h"
#include <zephyr/random/random.h>

#define CAN_TX1_PERIOD K_MSEC(CONFIG_CAN_TX1_PERIOD_MS)
#define CAN_TX2_PERIOD K_MSEC(CONFIG_CAN_TX2_PERIOD_MS)
#define CAN_TX3_PERIOD K_MSEC(CONFIG_CAN_TX3_PERIOD_MS)

void can_tx1_thread(void *arg1, void *arg2, void *arg3);
void can_tx2_thread(void *arg1, void *arg2, void *arg3);
void can_tx3_thread(void *arg1, void *arg2, void *arg3);
```
